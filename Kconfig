## Kconfig
```kconfig
# Copyright (c) 2024 The ZMK Contributors
# SPDX-License-Identifier: MIT

DT_COMPAT_DRV2605 := ti,drv2605

config DRV2605_ALT
  bool "Alternative DRV2605 haptic motor driver"
  # default $(dt_compat_enabled,$(DT_COMPAT_DRV2605_ALT))
	default y
	depends on DT_HAS_TI_DRV2605_ALT_ENABLED
  select I2C
  select SENSOR
  help
      Enable Alternative DRV2605 haptic motor driver.

if DRV2605_ALT

config DRV2605_ALT_GPIO
	bool "GPIO Wrapper of Alternative DRV2605"
	default y
	depends on DT_HAS_TI_DRV2605_ALT_GPIO_ENABLED
	depends on DRV2605_ALT
  select GPIO
	help
	  Enable the driver for Alternative DRV2605 GPIO.

module = DRV2605_ALT
module-str = DRV2605_ALT
source "${ZEPHYR_BASE}/subsys/logging/Kconfig.template.log_config"

endif #DRV2605_ALT
```

## dts/bindings/ti,drv2605-alt-gpio.yaml
```yaml
# Copyright (c) 2024 The ZMK Contributors
# SPDX-License-Identifier: MIT

description: GPIO wrapper for DRV2605 Haptic Feedback Motor Driver

compatible: "ti,drv2605-alt-gpio"

include: [gpio-controller.yaml]

properties:
  dev-reg:
    type: int
    required: true
    description: |
      DRV2605 instance reg property value. Used to match this GPIO controller
      with the corresponding DRV2605 device.

  "#gpio-cells":
    const: 2

gpio-cells:
  - pin
  - flags
```
